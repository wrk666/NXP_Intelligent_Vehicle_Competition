/*********************************************************************************************************************
 * COPYRIGHT NOTICE
 * Copyright (c) 2017,逐飞科技
 * All rights reserved.
 * 技术讨论QQ群：179029047
 *
 * 以下所有内容版权均属逐飞科技所有，未经允许不得用于商业用途，
 * 欢迎各位使用并传播本程序，修改内容时必须保留逐飞科技的版权声明。
 *
 * @file       		NRF24L01
 * @company	   		成都逐飞科技有限公司
 * @author     		逐飞科技(QQ3184284598)
 * @version    		v2.0
 * @Software 		IAR 7.7 or MDK 5.23
 * @Target core		S9KEA128AMLK
 * @Taobao   		https://seekfree.taobao.com/
 * @date       		2017-11-6
 * @note	
					6 PIN OLED接线定义：
					------------------------------------ 
					    OLED液晶    单片机
    					CLK          A2
    					MOSI         A3            
    					DC           D3    
    					CS           D2
					------------------------------------ 
 ********************************************************************************************************************/
#include "headfile.h"
#include "OLED.h"

//#include "stdio.h"
//#include <stdarg.h>
	 
#define XLevelL		0x00
#define XLevelH		0x10
#define XLevel		((XLevelH&0x0F)*16+XLevelL)
#define Max_Column	128
#define Max_Row		64
#define	Brightness	0xCF


#define X_WIDTH 128
#define Y_WIDTH 64
	 
#define OLED_SCL(x)  gpio_set (OLED_SCL_PIN	, x)
#define OLED_SDA(x)  gpio_set (OLED_SDA_PIN	, x)
#define OLED_RST(x)  gpio_set (OLED_RST_PIN	, x)
#define OLED_DC(x)   gpio_set (OLED_DC_PIN	, x)
#define OLED_CS(x)   gpio_set (OLED_CS_PIN  , x)
                                       
uint8_t Place_X = 0;
uint8_t Place_Y = 0;

const uint8 F6x8[][6] =
{
	{ 0x00, 0x00, 0x00, 0x00, 0x00, 0x00 },   // sp
	{ 0x00, 0x00, 0x00, 0x2f, 0x00, 0x00 },   // !
	{ 0x00, 0x00, 0x07, 0x00, 0x07, 0x00 },   // "
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	{ 0x14, 0x14, 0x14, 0x14, 0x14, 0x14 }    // horiz lines
};




const uint8 F8X16[]=
{
	0x00,0x00,0x00,0x00,0x00,0x00,0x00,0x00,0x00,0x00,0x00,0x00,0x00,0x00,0x00,0x00,//  0
	0x00,0x00,0x00,0xF8,0x00,0x00,0x00,0x00,0x00,0x00,0x00,0x33,0x30,0x00,0x00,0x00,//! 1
	0x00,0x10,0x0C,0x06,0x10,0x0C,0x06,0x00,0x00,0x00,0x00,0x00,0x00,0x00,0x00,0x00,//" 2
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	0x00,0x06,0x01,0x01,0x02,0x02,0x04,0x04,0x00,0x00,0x00,0x00,0x00,0x00,0x00,0x00,//~ 94
  
};



//内部使用用户无需调用
void OLED_WrDat(uint8 data)
{
	unsigned char i;
        OLED_DC(1);  
	for(i=0;i<8;i++) //发送一个八位数据 ,通过数据线的高低电平来传输数据
	{
		if((data << i) & 0x80)
		{
                        OLED_SDA(1);
		}
		else  
                  OLED_SDA(0);
                
                OLED_SCL(0);
                OLED_SCL(1);
	}
}

//内部使用用户无需调用
void OLED_Wr6Dat(uint8 data)
{
	uint8 i=6;
	
	OLED_DC(1);
	OLED_SCL(0);
	while(i--)
	{
	 	if(data&0x80){OLED_SDA(1);}
	 	else{OLED_SDA(0);}
	 	OLED_SCL(1);
	 	OLED_SCL(0);
	 	data<<=1;
	}
        
}

//内部使用用户无需调用
void OLED_WrCmd(uint8 cmd)
{	
	unsigned char i;
        OLED_DC(0);  
	for(i=0;i<8;i++) //发送一个八位数据 ,通过数据线的高低电平来传输数据
	{
		if((cmd << i) & 0x80)
		{
                        OLED_SDA(1);
		}
		else  
                  OLED_SDA(0);
                
                OLED_SCL(0);
                OLED_SCL(1);
	}
  
}

//内部使用用户无需调用
void OLED_DLY_ms(uint16 ms)
{
	uint16 a;
	while(ms)
	{
	 	a=16000;
	 	while(a--);
	 	ms--;
	}
	return;
}



//-------------------------------------------------------------------------------------------------------------------
//  @brief      OLED显示坐标设置
//  @param      x			x轴坐标设置
//  @param      y			y轴坐标设置
//  @return     void
//  @since      v1.0
//  Sample usage:			
//-------------------------------------------------------------------------------------------------------------------
void OLED_Set_Pos(uint8 x, uint8 y)
{
  OLED_WrCmd(0xb0+y);
  OLED_WrCmd(((x&0xf0)>>4)|0x10);
  OLED_WrCmd((x&0x0f)|0x01);
}

//-------------------------------------------------------------------------------------------------------------------
//  @brief      OLED清屏函数
//  @param      bmp_data	填充颜色选着(0x00 or 0xff)
//  @return     void
//  @since      v1.0
//  Sample usage:			
//-------------------------------------------------------------------------------------------------------------------
void OLED_Fill(uint8 bmp_data)
{
	uint8 y,x;
	
	for(y=0;y<8;y++)
	{
		OLED_WrCmd(0xb0+y);
		OLED_WrCmd(0x01);
		OLED_WrCmd(0x10);
		for(x=0;x<X_WIDTH;x++)	OLED_WrDat(bmp_data); 
	}
}


//-------------------------------------------------------------------------------------------------------------------
//  @brief      OLED初始化函数
//  @param      NULL
//  @return     void
//  @since      v1.0
//  Sample usage:			
//-------------------------------------------------------------------------------------------------------------------
void OLED_Init(void)
{   
       gpio_init (OLED_SCL_PIN, GPO,0);  //     CLK
       gpio_init (OLED_SDA_PIN, GPO,0);  //     MOSI
       gpio_init (OLED_CS_PIN, GPO,0); //     CS
       gpio_set (OLED_CS_PIN, 0);
       gpio_init (OLED_DC_PIN, GPO,0); //      DC

       port_pull (OLED_SCL_PIN);
       port_pull (OLED_SDA_PIN);
       port_pull (OLED_DC_PIN );

    
    OLED_WrCmd(0xae);//--turn off oled panel
    OLED_WrCmd(0x00);//---set low column address
    OLED_WrCmd(0x10);//---set high column address
    OLED_WrCmd(0x40);//--set start line address  Set Mapping RAM Display Start Line (0x00~0x3F)
    OLED_WrCmd(0x81);//--set contrast control register
    OLED_WrCmd(0xcf); // Set SEG Output Current Brightness
    OLED_WrCmd(0xa1);//--Set SEG/Column Mapping     0xa0左右反置 0xa1正常
    OLED_WrCmd(0xc8);//Set COM/Row Scan Direction   0xc0上下反置 0xc8正常
    OLED_WrCmd(0xa6);//--set normal display
    OLED_WrCmd(0xa8);//--set multiplex ratio(1 to 64)
    OLED_WrCmd(0x3f);//--1/64 duty
    OLED_WrCmd(0xd3);//-set display offset	Shift Mapping RAM Counter (0x00~0x3F)
    OLED_WrCmd(0x00);//-not offset
    OLED_WrCmd(0xd5);//--set display clock divide ratio/oscillator frequency
    OLED_WrCmd(0x80);//--set divide ratio, Set Clock as 100 Frames/Sec
    OLED_WrCmd(0xd9);//--set pre-charge period
    OLED_WrCmd(0xf1);//Set Pre-Charge as 15 Clocks & Discharge as 1 Clock
    OLED_WrCmd(0xda);//--set com pins hardware configuration
    OLED_WrCmd(0x12);
    OLED_WrCmd(0xdb);//--set vcomh
    OLED_WrCmd(0x40);//Set VCOM Deselect Level
    OLED_WrCmd(0x20);//-Set Page Addressing Mode (0x00/0x01/0x02)
    OLED_WrCmd(0x02);//
    OLED_WrCmd(0x8d);//--set Charge Pump enable/disable
    OLED_WrCmd(0x14);//--set(0x10) disable
    OLED_WrCmd(0xa4);// Disable Entire Display On (0xa4/0xa5)
    OLED_WrCmd(0xa6);// Disable Inverse Display On (0xa6/a7)
    OLED_WrCmd(0xaf);//--turn on oled panel
    OLED_Fill(0x00);  //初始清屏
    OLED_Set_Pos(0,0);
}

//-------------------------------------------------------------------------------------------------------------------
//  @brief      OLED点亮一个点
//  @param      x			x轴坐标设置
//  @param      y           y轴坐标设置
//  @return     void
//  @since      v1.0
//  Sample usage:			
//-------------------------------------------------------------------------------------------------------------------
void OLED_PutPixel(uint8 x,uint8 y)
{
	uint8 data1;  //data1当前点的数据
	
	OLED_Set_Pos(x,y);
	data1 = 0x01<<(y%8);
	OLED_WrCmd(0xb0+(y>>3));
	OLED_WrCmd(((x&0xf0)>>4)|0x10);
	OLED_WrCmd((x&0x0f)|0x00);
	OLED_WrDat(data1);
}

//-------------------------------------------------------------------------------------------------------------------
//  @brief      OLED清除一个点
//  @param      x			x轴坐标设置
//  @param      y           y轴坐标设置
//  @return     void
//  @since      v1.0
//  Sample usage:			
//-------------------------------------------------------------------------------------------------------------------
void OLED_ClrPixel(uint8 x,uint8 y)
{
	uint8 data1;  //data1当前点的数据
	
	OLED_Set_Pos(x,y);
	data1 = 0x00<<(y%8);
	OLED_WrCmd(0xb0+(y>>3));
	OLED_WrCmd(((x&0xf0)>>4)|0x10);
	OLED_WrCmd((x&0x0f)|0x00);
	OLED_WrDat(data1);
}


//-------------------------------------------------------------------------------------------------------------------
//  @brief      OLED显示字符串(6*8字体)
//  @param      x			x轴坐标设置
//  @param      y           y轴坐标设置
//  @param      ch[]        字符串
//  @return     void
//  @since      v1.0
//  Sample usage:			
//-------------------------------------------------------------------------------------------------------------------
void OLED_P6x8Str(uint8 x,uint8 y,const uint8 ch[])
{
	uint8 c=0,i=0,j=0;
	while (ch[j]!='\0')
	{
          if(ch[j] == '\n')
          {
            x = 0;
            y++;
            OLED_Set_Pos(x,y);
          }
          if(ch[j]!= '\n')
            c =ch[j]-32;
          else
            c = ch[j];
          
          if(x>126){x=0;y++;}
            OLED_Set_Pos(x,y);
          
          if(ch[j] != '\n'){
            for(i=0;i<6;i++)	
              OLED_WrDat(F6x8[c][i]);
            x+=6;
          }
          else x = 0;
          
          j++;
	}
        //当前光标位置
        Place_Y = y;
        Place_X = x;
}

//------------------------------display number-------------------------------------------------------
void OLED_P6x8str(unsigned char x,unsigned char y,unsigned char ch[])
{
	unsigned char c=0,i=0,j=0;
	while (ch[j]!='\0')
	{
		c =ch[j]-32;
		if(x>126){x=0;y++;}
		OLED_Set_Pos(x,y);
		for(i=0;i<6;i++)
		OLED_WrDat(F6x8[c][i]);
		x+=6;
		j++;
	}
}
void Show_bit(uint8_t num , uint8_t x ,uint8_t y)    //显示数字
{ 
  uint8_t  X=0;
  X = num;
  switch (X)
  {
    case 0:
      OLED_P6x8str(x,y,"0");
      break;
    case 1:
      OLED_P6x8str(x,y,"1");
      break;
    case 2:
      OLED_P6x8str(x,y,"2");
      break;
    case 3:
      OLED_P6x8str(x,y,"3");
      break;
    case 4:
      OLED_P6x8str(x,y,"4");
      break;
    case 5:
      OLED_P6x8str(x,y,"5");
      break;
    case 6:
      OLED_P6x8str(x,y,"6");
      break;
    case 7:
      OLED_P6x8str(x,y,"7");
      break;
    case 8:
      OLED_P6x8str(x,y,"8");
      break;
    case 9:
      OLED_P6x8str(x,y,"9");
      break;
    case 10:
      OLED_P6x8str(x,y," ");
      break;
    default :
      break;
  }
}
void Get_Bit(float num ,uint8 x ,uint8 y)  //提取数字的位
{
  uint8 a,b,c,d,e,f;
  //若是正数
  if(num>0)
  {
 //   OLED_P6x8str(x+6,y,"+");
        OLED_P6x8str(x,y,"+");

     if(num>999)  //若整数部分是四位数  6X8显示
     {  
        a = ((int)num)/1000;                              if(a>0) {Show_bit( a, x+6 ,y);}
        b = ((int)num%1000)/100;                           if(a>0||b>0) {Show_bit( b, x+12 ,y); }
        c = ((int)num%100)/10;                             Show_bit( c, x+18 ,y);
        d =  (int)num%10;                                 Show_bit(d,x+24 ,y);
        OLED_P6x8str(x+24,y,".");
        OLED_P6x8str(x+30,y,"0");
     }
    else   //若整数部分小于四位数
    {
      
      a = ((int)num)/100;                              if(a>0) {Show_bit( a, x+12 ,y);}   else Show_bit(0, x+12 ,y);
      b = ((int)num%100)/10;                           if(a>0||b>0) {Show_bit( b, x+18 ,y); }  else Show_bit(0, x+18 ,y);
      c = ((int)num)%10;                                       Show_bit( c, x+24 ,y);
      OLED_P6x8str(x+30,y,".");
      d = ((int)(num*10))%10; Show_bit(d,x+36 ,y);
      e = ((int)(num*100))%10; Show_bit(e,x+42 ,y);
      f = ((int)(num*1000))%10; Show_bit(f,x+48,y);
      
    }
  }
  //若是负数
  else
  {
    num =(0.0-num);
    OLED_P6x8str(x+6,y,"-");
    a = ((int)num)/100;                                  if(a>0) { Show_bit( a, x+12 ,y);}   else Show_bit(' ', x+12 ,y);
    b = ((int)num%100)/10;                               if(a>0||b>0) { Show_bit( b, x+18 ,y);}   else Show_bit(0, x+18 ,y);
    c = ((int)num)%10;                                             Show_bit( c, x+24 ,y); 
    OLED_P6x8str(x+30,y,".");
    d = ((int)(num*10))%10; Show_bit(d,x+36 ,y);
    e = ((int)(num*100))%10; Show_bit(e,x+42 ,y);
    f = ((int)(num*1000))%10; Show_bit(f,x+48,y);
  }
  
}
///////////////////////////////////////////////////////////////////////
///////////////above codes display number//////////////////////////////
//////////////////////////////////////////////////////////////////////
//-----------------------------------------------------------------------

//-------------------------------------------------------------------------------------------------------------------
//  @brief      OLED显示字符串(8*16字体)
//  @param      x			x轴坐标设置
//  @param      y           y轴坐标设置
//  @param      ch[]        字符串
//  @return     void
//  @since      v1.0
//  Sample usage:			
//-------------------------------------------------------------------------------------------------------------------
void OLED_P8x16Str(uint8 x,uint8 y,uint8 ch[])
{
	uint8 c=0,i=0,j=0;
	
	while (ch[j]!='\0')
	{
	  	c =ch[j]-32;
	  	if(x>120){x=0;y++;}
		
	  	OLED_Set_Pos(x,y);
	  	for(i=0;i<8;i++)	OLED_WrDat(F8X16[c*16+i]);
	  	  
	  	OLED_Set_Pos(x,y+1);
	  	for(i=0;i<8;i++)	OLED_WrDat(F8X16[c*16+i+8]);
	  	  
	  	x+=8;
	  	j++;
	}
}


//内部使用用户无需调用
void OLED_HEXACSII(uint16 hex,uint8* Print)
{
	uint8 hexcheck ;
	uint8 TEMP ;
	TEMP = 6 ;
	Print[TEMP ]='\0';
	while(TEMP)
	{
            TEMP -- ;
            hexcheck  =  hex%10 ;
            hex   /=10 ;
            Print[TEMP]  = hexcheck + 0x30 ;
	}
  
}

//-------------------------------------------------------------------------------------------------------------------
//  @brief      OLED显示无符号数(8*16字体)
//  @param      x			x轴坐标设置
//  @param      y           y轴坐标设置
//  @param      num         无符号数
//  @return     void
//  @since      v1.0
//  Sample usage:			
//-------------------------------------------------------------------------------------------------------------------
void OLED_Print_Num(uint8 x, uint8 y, uint16 num)
{
	uint8 *ch1,ch[7];
	
	OLED_HEXACSII(num,ch);
	ch1 =&ch[1];
	while(*ch1 != '\0')
	{
        OLED_P6x8Str(x, y, ch1);	//显示数字
	    x += 6;
        ch1++;
	}
}

//-------------------------------------------------------------------------------------------------------------------
//  @brief      OLED显示有符号数(6*8字体)
//  @param      x			x轴坐标设置
//  @param      y           y轴坐标设置
//  @param      num         有符号数
//  @return     void
//  @since      v1.0
//  Sample usage:			
//-------------------------------------------------------------------------------------------------------------------
void OLED_Print_Num1(uint8 x, uint8 y, int16 num)
{
	uint8_t *ch1,ch[7];
	if(num<0)   {num = -num;OLED_P6x8Str(x, y, (uint8 *)"-");}
	else         OLED_P6x8Str(x, y, (uint8 *)" ");
	x+=6;
	
        OLED_HEXACSII(num,ch);
	ch1 =&ch[1];
	while(*ch1 != '\0')
	{
		OLED_P6x8Str(x, y, ch1);	//显示数字
		x += 6;
		ch1++;
	}
}

//-------------------------------------------------------------------------------------------------------------------
//  @brief      OLED显示图像
//  @param      high  		图像高度
//  @param      width 		图像宽度
//  @param      *p    		图像地址（数组）
//  @param      value 		二值化阀值
//  @return     void
//  @since      v1.0
//  Sample usage:			
//-------------------------------------------------------------------------------------------------------------------
void dis_bmp(uint16 high, uint16 width, uint8 *p,uint8 value)
{
    int16 i,j;
    int16 temp,temp1;
    uint8 dat;
    
    
    temp1 = high%8;
    if(temp1 == 0) temp = high/8;
    else           temp = high/8+1;
    
 
    for(i=0; i<temp; i++)
    {
        OLED_Set_Pos(0,i);
        for(j=0; j<width; j++)
        {
            dat = 0;
            if( i<(temp-1) || !temp1 || temp1>=1)dat |= (*(p+i*8*width+j+width*0) > value? 1: 0)<<0;
            if( i<(temp-1) || !temp1 || temp1>=2)dat |= (*(p+i*8*width+j+width*1) > value? 1: 0)<<1;
            if( i<(temp-1) || !temp1 || temp1>=3)dat |= (*(p+i*8*width+j+width*2) > value? 1: 0)<<2;
            if( i<(temp-1) || !temp1 || temp1>=4)dat |= (*(p+i*8*width+j+width*3) > value? 1: 0)<<3;
            if( i<(temp-1) || !temp1 || temp1>=5)dat |= (*(p+i*8*width+j+width*4) > value? 1: 0)<<4;
            if( i<(temp-1) || !temp1 || temp1>=6)dat |= (*(p+i*8*width+j+width*5) > value? 1: 0)<<5;
            if( i<(temp-1) || !temp1 || temp1>=7)dat |= (*(p+i*8*width+j+width*6) > value? 1: 0)<<6;
            if( i<(temp-1) || !temp1 || temp1>=8)dat |= (*(p+i*8*width+j+width*7) > value? 1: 0)<<7;
           
            OLED_WrDat(dat);
        }
    }
}


void OLED_P6x8char(uint8 x,uint8 y,uint8 ch)
{
    uint8_t i = 0,c = 0;
    c = ch-32;
    OLED_Set_Pos(x,y);
    for(i=0;i<6;i++)	OLED_WrDat(F6x8[c][i]);

    //当前光标位置
    Place_Y = y;
    Place_X = x+6;
}


//printf 函数重定向到OLED显示
int Fputc(int ch, FILE *f)
{      
    static uint8_t x = 0, y = 0;
    if(ch == '\n')    //换行
    { 
        x = 0; 
        y += 1; 
        return ch; 
    }
    if(x + 6 > 128)  //宽不能超过128
    { 
        x = 0;           //x置零
        y += 1;         //y移至下一行
    } 
    if(y + 1 > 7)  //行不超过7
    { 
        y=0;
        OLED_Fill(0x00); //直接清屏 重头开始
        x = 0;
    }

    OLED_P6x8char(x, y, (uint8_t)ch); //打印字符ch
    x += 6;                   //跳转到下一个位置, 是否越界有上面函数判断
    return ch; 
}

//浮点数转换成字符串函数
//传入参数：num：要转换的浮点数
//            n：转换精度（保留几位小数）
//传出参数：uint8_t* num_str：转换的字符串首地址
//用法：printf("%f",float2str(3.14,2)); //打印浮点数3.14，保留两位小数
//
//注意：整数部分最大6位整数，大小超过6位整数会出问题，小数精度会跟随整数
//      长度进行变化，整数+小数最大为10位。例如整数为6位数时，最多显示4位小数
//      整数为1位数时，最多显示9位小数。
uint8_t* float2str(double num,int n){

    int i = 0;
    static uint8_t num_str[13] = {'\0'}; 
    uint8_t len = 0;
    uint8_t n_max = 0; //小数点最大位数
    
    for(i = 0;i<13;i++) //字符串清空
      num_str[i] = '\0';
    //确定符号
    if(num > 0){
    
      num_str[0] = '+';
    }
    else if(num < 0){
    
      num_str[0] = '-';
      num = -num;
    }
    
    //确定整数部分长度
    if((int)(num/100000) != 0){ //6位数
      len = 7;
      n_max = 4;
    }
    else if((int)(num/10000) != 0){ //5位数
        len = 6;
        n_max = 5;
    }
    else if((int)(num/1000) != 0){ //4位数
        len = 5;
        n_max = 6;
    }
    else if((int)(num/100) != 0){  //3位数
        len = 4;
        n_max = 7;
    }
    else if((int)(num/10) != 0){ //2位数
        len = 3;
        n_max = 8;
    }
    else{ //1位数
        len = 2;
        n_max = 9;
    }
    
    //小数点限幅
    if(n > n_max)
        n = n_max;
    len+=n; //确定长度
    
    //变成整数
    i = n;
    while(i--)
        num = (num*10);
    
    //inum = num;
    
    //转换小数
    while(n--){ 
    
        num_str[len--] = (int)num%10+0x30;
        num = num/10;
    }
    num_str[len] = '.';
    
    //转换整数
    while(len--){ 
    
        num_str[len] = (int)num%10+0x30;
        num = num/10;
        if(len == 1)
          break;
    }
    return num_str;
}

////////////////////////////////////////////////////////////////////////////////////////////////
//OLED上的printf，除了要输入坐标其他地方和printf用法一样
//由于IAR平台的问题，不修改stdio底层，不能使用 %f 输出浮点数
//
//传入参数：   x:要显示位置的x坐标，x<=127
//             y:要显示位置的y坐标, y<=7
//             const char *pFormat, ... ：用法和printf一样
//传出参数：   result打印的结果
//
//用法实例：OLED_printf(0,0,"hello world"); //在液晶（0,0）位置打印"hello world"
//          OLED_printf(0,1,"a = %d",a);    //在液晶（0,1）位置打印变量a
//          反正除了要输入坐标其他用法和printf一模一样
//          OLED_printf(0,2,"%.2f",3.14); //修改底层之后也能输出浮点数
//
//没有修改stdio底层的情况下：
//要输出浮点数的解决方法：调用float2num函数把浮点数转换为字符串用 %s 输出
//浮点数输出实例： OLED_printf(0,2,"%s",float2str(3.14,2)); //在（0,2）位置输出3.14
//
//有时候需要接着之前的输出打印数据，重新计算坐标会很麻烦，可以使用get_x()和get_y()
//获取当前坐标位置实现接着之前的输入打印数据
//用法实例：OLED_printf(get_x(),get_y(),"prit");//接着当前坐标打印了 "prit"
//
//注意：OLED_printf会和printf冲突，只能同时使用一个
//      使用float2str()函数进行浮点转字符串的时候，一个OLED_printf();只能
//      输出一个浮点数，如果想OLED_printf(0,2,"%s %s",float2str(3.14,2) , float2str(1.2,1));
//      的话，会出错，结果显示的是打印出来两个 3.14 而不是 3.14 1.2
////////////////////////////////////////////////////////////////////////////////////////////////
signed int OLED_printf(uint8_t x,uint8_t y,const char *pFormat, ...){
    
    char pStr[25] = {'\0'}; 
    va_list ap;
    signed int result;
     
     //Forward call to vprintf
    va_start(ap, pFormat);
    result = vsprintf((char *)pStr, pFormat, ap);
    va_end(ap);

    OLED_P6x8Str(x,y,(const uint8_t *)pStr); 

    return result;
}

//得到当前X坐标
uint8_t getx(){

    return Place_X;
}

//得到当前Y坐标
uint8_t gety(){

    return Place_Y;
}
